// Minimal 1-bpp drawing into the panel framebuffer (MSB first, 1 = white).
// A 5x7 bitmap font scaled up is enough for a diagnostics screen and means the
// firmware needs no font engine.
#pragma once
#include <stdint.h>
#include <string.h>
#include <ctype.h>

class Draw {
 public:
  Draw(uint8_t* fb, int width, int height) : fb_(fb), w_(width), h_(height), stride_(width / 8) {}

  void pixel(int x, int y, bool black) {
    if (x < 0 || y < 0 || x >= w_ || y >= h_) return;
    uint8_t& b = fb_[y * stride_ + (x >> 3)];
    const uint8_t m = 0x80 >> (x & 7);
    if (black) b &= ~m; else b |= m;
  }

  void rect(int x0, int y0, int w, int h, bool black = true) {
    for (int y = y0; y < y0 + h; y++)
      for (int x = x0; x < x0 + w; x++) pixel(x, y, black);
  }

  void frame(int x0, int y0, int w, int h, int t = 2) {
    rect(x0, y0, w, t); rect(x0, y0 + h - t, w, t); rect(x0, y0, t, h); rect(x0 + w - t, y0, t, h);
  }

  // Thick line, for the odd diagonal (lightning bolt).
  void line(int x0, int y0, int x1, int y1, int t = 2) {
    const int steps = (abs(x1 - x0) > abs(y1 - y0) ? abs(x1 - x0) : abs(y1 - y0)) + 1;
    for (int i = 0; i < steps; i++) {
      const int x = x0 + (x1 - x0) * i / steps, y = y0 + (y1 - y0) * i / steps;
      rect(x, y, t, t);
    }
  }

  // Upper-case 5x7 font, scaled. Returns the x position after the text.
  int text(int x, int y, const char* s, int scale = 3) {
    for (; *s; s++) {
      unsigned char c = toupper((unsigned char)*s);
      if (c < 0x20 || c > 0x5F) c = '?';
      const uint8_t* g = FONT[c - 0x20];
      for (int col = 0; col < 5; col++)
        for (int row = 0; row < 8; row++)
          if (g[col] & (1 << row)) rect(x + col * scale, y + row * scale, scale, scale);
      x += 6 * scale;
    }
    return x;
  }

  // Battery glyph: outline with a nub, fill proportional to percent, bolt when charging.
  void battery(int x, int y, int percent, bool charging) {
    const int w = 40, h = 18;
    frame(x, y, w, h, 2);
    rect(x + w, y + 5, 3, 8);
    const int inner = w - 8;
    const int fill = percent < 0 ? 0 : (inner * (percent > 100 ? 100 : percent) + 50) / 100;
    rect(x + 4, y + 4, fill, h - 8);
    if (charging) {
      // white bolt over whatever fill is there, then black so it shows on both
      line(x + 22, y + 2, x + 15, y + 10, 3); line(x + 15, y + 10, x + 24, y + 9, 3); line(x + 24, y + 9, x + 17, y + 16, 3);
      line(x + 22, y + 3, x + 16, y + 10, 1); line(x + 16, y + 10, x + 23, y + 9, 1); line(x + 23, y + 9, x + 18, y + 15, 1);
    }
  }

 private:
  uint8_t* fb_;
  int w_, h_, stride_;

  static constexpr uint8_t FONT[64][5] = {
      {0x00,0x00,0x00,0x00,0x00},{0x00,0x00,0x5F,0x00,0x00},{0x00,0x07,0x00,0x07,0x00},{0x14,0x7F,0x14,0x7F,0x14},
      {0x24,0x2A,0x7F,0x2A,0x12},{0x23,0x13,0x08,0x64,0x62},{0x36,0x49,0x56,0x20,0x50},{0x00,0x08,0x07,0x03,0x00},
      {0x00,0x1C,0x22,0x41,0x00},{0x00,0x41,0x22,0x1C,0x00},{0x2A,0x1C,0x7F,0x1C,0x2A},{0x08,0x08,0x3E,0x08,0x08},
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      {0x02,0x04,0x08,0x10,0x20},{0x00,0x41,0x41,0x41,0x7F},{0x04,0x02,0x01,0x02,0x04},{0x40,0x40,0x40,0x40,0x40}};
};
